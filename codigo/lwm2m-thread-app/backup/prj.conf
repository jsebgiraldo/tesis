## CMakeLists.txt
```
cmake_minimum_required(VERSION 3.20.0)
find_package(Zephyr REQUIRED HINTS $ENV{ZEPHYR_BASE})

project(ami-lwm2m-client
    VERSION 0.3.0
    DESCRIPTION "AMI Node: LwM2M client over Thread (ESP32-C6)"
    LANGUAGES C
)

# Application sources
FILE(GLOB app_sources src/*.c)
target_sources(app PRIVATE ${app_sources})
```

## Kconfig
```
# Private Kconfig for AMI LwM2M Client

mainmenu "AMI LwM2M Client"

config NET_SAMPLE_LWM2M_ID
	string "LwM2M Client identity"
	default ""
	help
	  Client endpoint name for LwM2M registration.
	  Leave empty to use CONFIG_BOARD.

config NET_SAMPLE_LWM2M_SERVER
	string "LwM2M server address"
	default "coap://[fdde:ad00:beef::2]:5683"
	help
	  LwM2M server address. Full URI including port.
	  IPv6 addresses must be in square brackets.

config AMI_FW_VERSION
	string "AMI Firmware version"
	default "0.3.0"
	help
	  Firmware version reported via LwM2M Device Object.

source "Kconfig.zephyr"
```

## sysbuild.conf
```
# Sysbuild: enable MCUboot bootloader (dual-slot swap)
SB_CONFIG_BOOTLOADER_MCUBOOT=y
```

## prj.conf
```kconfig
# ============================================================================
# AMI LwM2M Client over OpenThread — prj.conf
# Target: XIAO ESP32-C6 (Seeed Studio)
#
# Based on Zephyr samples/net/lwm2m_client with overlay-ot.conf
# ============================================================================

# --- General ---
CONFIG_LOG=y
CONFIG_LOG_DEFAULT_LEVEL=3
CONFIG_LOG_BACKEND_UART=y
CONFIG_PRINTK=y
CONFIG_SHELL=y
CONFIG_ASSERT=y
CONFIG_REBOOT=y
CONFIG_HEAP_MEM_POOL_SIZE=65536
CONFIG_MAIN_STACK_SIZE=4096
CONFIG_SYSTEM_WORKQUEUE_STACK_SIZE=2048
CONFIG_BOOT_DELAY=1000

# --- Networking (IPv6-only over Thread) ---
CONFIG_NETWORKING=y
CONFIG_NET_IPV6=y
CONFIG_NET_IPV4=n
CONFIG_NET_TCP=n
CONFIG_NET_UDP=y
CONFIG_NET_SOCKETS=y
CONFIG_NET_MAX_CONTEXTS=5
CONFIG_NET_PKT_RX_COUNT=10
CONFIG_NET_PKT_TX_COUNT=10
CONFIG_NET_BUF_RX_COUNT=16
CONFIG_NET_BUF_TX_COUNT=16
CONFIG_NET_IF_UNICAST_IPV6_ADDR_COUNT=6
CONFIG_NET_IF_MCAST_IPV6_ADDR_COUNT=8
CONFIG_NET_IPV6_NBR_CACHE=n
CONFIG_NET_IPV6_MLD=n

# --- Connection Manager (handles L4 up/down events) ---
CONFIG_NET_CONNECTION_MANAGER=y
CONFIG_NET_CONFIG_SETTINGS=y
CONFIG_NET_CONFIG_NEED_IPV6=y
CONFIG_NET_CONFIG_NEED_IPV4=n
CONFIG_NET_CONFIG_MY_IPV4_ADDR=""
CONFIG_NET_CONFIG_PEER_IPV4_ADDR=""
# Server address — use mesh-local prefix
CONFIG_NET_SAMPLE_LWM2M_SERVER="coap://[fdde:ad00:beef::2]:5683"

# --- OpenThread (FTD) ---
CONFIG_NET_L2_OPENTHREAD=y
CONFIG_OPENTHREAD=y
CONFIG_OPENTHREAD_FTD=y
CONFIG_OPENTHREAD_SHELL=y
CONFIG_OPENTHREAD_CHANNEL=25
CONFIG_OPENTHREAD_PANID=43981
CONFIG_OPENTHREAD_XPANID="12:34:56:78:90:AB:CD:EF"
CONFIG_OPENTHREAD_NETWORKKEY="00:11:22:33:44:55:66:77:88:99:AA:BB:CC:DD:EE:FF"
CONFIG_OPENTHREAD_NETWORK_NAME="AMI-Pilot-2025"
CONFIG_OPENTHREAD_JOINER=y
CONFIG_OPENTHREAD_DNS_CLIENT=y
CONFIG_OPENTHREAD_SRP_CLIENT=y
CONFIG_OPENTHREAD_COAP=y
CONFIG_OPENTHREAD_DEFAULT_TX_POWER=8
CONFIG_OPENTHREAD_THREAD_VERSION_1_3=y

CONFIG_OPENTHREAD_DEBUG=y
CONFIG_OPENTHREAD_L2_DEBUG=y
CONFIG_OPENTHREAD_L2_LOG_LEVEL_INF=y

# Shell stack for OT shell
CONFIG_SHELL_STACK_SIZE=3072

# --- mbedTLS ---
CONFIG_MBEDTLS=y
CONFIG_MBEDTLS_BUILTIN=y
CONFIG_MBEDTLS_SSL_MAX_CONTENT_LEN=768

# --- LwM2M Client ---
CONFIG_LWM2M=y
CONFIG_LWM2M_LOG_LEVEL_INF=y
CONFIG_LWM2M_COAP_BLOCK_SIZE=512
CONFIG_LWM2M_SHELL=y
CONFIG_LWM2M_ENGINE_MAX_OBSERVER=10
CONFIG_LWM2M_ENGINE_MAX_MESSAGES=10
CONFIG_LWM2M_ENGINE_MAX_PENDING=10
CONFIG_LWM2M_ENGINE_MAX_REPLIES=10
CONFIG_LWM2M_ENGINE_STACK_SIZE=4096
CONFIG_LWM2M_ENGINE_DEFAULT_LIFETIME=300

# LwM2M IPSO objects
CONFIG_LWM2M_IPSO_SUPPORT=y
CONFIG_LWM2M_IPSO_TEMP_SENSOR=y
CONFIG_LWM2M_IPSO_VOLTAGE_SENSOR=y
CONFIG_LWM2M_IPSO_CURRENT_SENSOR=y
CONFIG_LWM2M_IPSO_GENERIC_SENSOR=y
CONFIG_LWM2M_IPSO_GENERIC_SENSOR_INSTANCE_COUNT=2
CONFIG_LWM2M_IPSO_LIGHT_CONTROL=y
CONFIG_LWM2M_CONN_MON_OBJ_SUPPORT=y

# LwM2M Firmware Update Object (ID 5)
CONFIG_LWM2M_FIRMWARE_UPDATE_OBJ_SUPPORT=y
CONFIG_LWM2M_FIRMWARE_UPDATE_PULL_SUPPORT=y

# CoAP extended options for long endpoints
CONFIG_COAP=y
CONFIG_COAP_EXTENDED_OPTIONS_LEN=y
CONFIG_COAP_EXTENDED_OPTIONS_LEN_VALUE=40

# --- NVS (persistent storage) ---
CONFIG_NVS=y
CONFIG_FLASH=y
CONFIG_FLASH_MAP=y
CONFIG_SETTINGS=y
CONFIG_SETTINGS_NVS=y

# --- GPIO (LED, tamper) ---
CONFIG_GPIO=y

# --- Serial (USB console + RS-485) ---
CONFIG_SERIAL=y
CONFIG_SERIAL_ESP32_USB=y
CONFIG_UART_INTERRUPT_DRIVEN=y

# --- Watchdog (disabled at boot — Thread init can take >30s) ---
CONFIG_WATCHDOG=y
CONFIG_WDT_DISABLE_AT_BOOT=y

# --- Random ---
CONFIG_TEST_RANDOM_GENERATOR=y

# --- MCUboot + FOTA ---
CONFIG_BOOTLOADER_MCUBOOT=y
CONFIG_IMG_MANAGER=y
CONFIG_MCUBOOT_IMG_MANAGER=y
CONFIG_IMG_ERASE_PROGRESSIVELY=y
CONFIG_IMG_ENABLE_IMAGE_CHECK=y
CONFIG_IMG_BLOCK_BUF_SIZE=512
CONFIG_STREAM_FLASH=y

# --- Debug ---
CONFIG_THREAD_ANALYZER=y
CONFIG_THREAD_NAME=y
CONFIG_EXCEPTION_STACK_TRACE=y
CONFIG_FAULT_DUMP=2
CONFIG_EXTRA_EXCEPTION_INFO=y
CONFIG_EARLY_CONSOLE=y
CONFIG_IEEE802154_DRIVER_LOG_LEVEL_WRN=y

# --- Floating point printf ---
CONFIG_CBPRINTF_FP_SUPPORT=y
```

## src/main.c
```c
/*
 * main.c — AMI LwM2M Client over OpenThread
 *
 * Based on Zephyr samples/net/lwm2m_client pattern:
 *   1. Wait for network connectivity (conn_mgr / L4 connected event)
 *   2. Setup LwM2M objects (Device, AMI sensors, FOTA)
 *   3. Start RD client registration
 *   4. Application loop updates sensor values periodically
 *
 * The OpenThread network is managed by Zephyr's L2 layer + Kconfig.
 * The Active Dataset is optionally injected from raw TLVs for exact
 * OTBR partition match.
 */

#define LOG_MODULE_NAME ami_lwm2m_client
#define LOG_LEVEL LOG_LEVEL_DBG

#include <zephyr/logging/log.h>
LOG_MODULE_REGISTER(LOG_MODULE_NAME);

#include <zephyr/kernel.h>
#include <zephyr/drivers/gpio.h>
#include <zephyr/drivers/hwinfo.h>
#include <zephyr/net/lwm2m.h>
#include <zephyr/net/conn_mgr_monitor.h>
#include <zephyr/net/conn_mgr_connectivity.h>
#include <zephyr/net/openthread.h>
#include <zephyr/sys/reboot.h>
#include <zephyr/random/random.h>

#include "modules.h"

#define APP_BANNER "AMI LwM2M Client v" CONFIG_AMI_FW_VERSION

/* --- LwM2M Device Object constants --- */
#define CLIENT_MANUFACTURER   "Espressif"
#define CLIENT_MODEL_NUMBER   "XIAO-ESP32-C6"
#define CLIENT_SERIAL_NUMBER  "SN-AMI-001"
#define CLIENT_FIRMWARE_VER   CONFIG_AMI_FW_VERSION
#define CLIENT_HW_VER         "1.0"
#define CLIENT_DEVICE_TYPE    "AMI Smart Meter Node"

/* Endpoint: use Kconfig if set, else board name */
static const char *endpoint =
	(sizeof(CONFIG_NET_SAMPLE_LWM2M_ID) > 1 ?
	 CONFIG_NET_SAMPLE_LWM2M_ID : CONFIG_BOARD);

static struct lwm2m_ctx client_ctx;
static struct k_sem quit_lock;

/* Zephyr NET management event callbacks */
static struct net_mgmt_event_callback l4_cb;
static struct net_mgmt_event_callback conn_cb;
static K_SEM_DEFINE(network_connected_sem, 0, 1);

/* LED */
static const struct gpio_dt_spec led_status =
	GPIO_DT_SPEC_GET_OR(DT_ALIAS(led0), gpios, {0});

/* ------------------------------------------------------------------ */
/* Device Object (3) callbacks                                         */
/* ------------------------------------------------------------------ */

static int device_reboot_cb(uint16_t obj_inst_id,
			    uint8_t *args, uint16_t args_len)
{
	LOG_WRN("Reboot requested via LwM2M");
	k_sleep(K_SECONDS(1));
	sys_reboot(SYS_REBOOT_COLD);
	return 0;
}

static int device_factory_default_cb(uint16_t obj_inst_id,
				     uint8_t *args, uint16_t args_len)
{
	LOG_INF("Factory default requested via LwM2M");
	return 0;
}

/* ------------------------------------------------------------------ */
/* LwM2M setup: all objects                                            */
/* ------------------------------------------------------------------ */

static int lwm2m_setup(void)
{
	/* Security Object (0) — server URI + mode */
	lwm2m_set_string(&LWM2M_OBJ(0, 0, 0), CONFIG_NET_SAMPLE_LWM2M_SERVER);
	lwm2m_set_u8(&LWM2M_OBJ(0, 0, 2), 3);   /* NoSec */

	/*
	 * Match Security object with Server object via Short Server ID.
	 * Security(0)/0/10 = SSID,  Server(1)/0/0 = SSID
	 */
	lwm2m_set_u16(&LWM2M_OBJ(0, 0, 10), CONFIG_LWM2M_SERVER_DEFAULT_SSID);
	lwm2m_set_u16(&LWM2M_OBJ(1, 0, 0), CONFIG_LWM2M_SERVER_DEFAULT_SSID);

	/* Device Object (3) */
	lwm2m_set_res_buf(&LWM2M_OBJ(3, 0, 0), CLIENT_MANUFACTURER,
			  sizeof(CLIENT_MANUFACTURER),
			  sizeof(CLIENT_MANUFACTURER), LWM2M_RES_DATA_FLAG_RO);
	lwm2m_set_res_buf(&LWM2M_OBJ(3, 0, 1), CLIENT_MODEL_NUMBER,
			  sizeof(CLIENT_MODEL_NUMBER),
			  sizeof(CLIENT_MODEL_NUMBER), LWM2M_RES_DATA_FLAG_RO);
	lwm2m_set_res_buf(&LWM2M_OBJ(3, 0, 2), CLIENT_SERIAL_NUMBER,
			  sizeof(CLIENT_SERIAL_NUMBER),
			  sizeof(CLIENT_SERIAL_NUMBER), LWM2M_RES_DATA_FLAG_RO);
	lwm2m_set_res_buf(&LWM2M_OBJ(3, 0, 3), CLIENT_FIRMWARE_VER,
			  sizeof(CLIENT_FIRMWARE_VER),
			  sizeof(CLIENT_FIRMWARE_VER), LWM2M_RES_DATA_FLAG_RO);
	lwm2m_register_exec_callback(&LWM2M_OBJ(3, 0, 4), device_reboot_cb);
	lwm2m_register_exec_callback(&LWM2M_OBJ(3, 0, 5),
				     device_factory_default_cb);
	lwm2m_set_res_buf(&LWM2M_OBJ(3, 0, 17), CLIENT_DEVICE_TYPE,
			  sizeof(CLIENT_DEVICE_TYPE),
			  sizeof(CLIENT_DEVICE_TYPE), LWM2M_RES_DATA_FLAG_RO);
	lwm2m_set_res_buf(&LWM2M_OBJ(3, 0, 18), CLIENT_HW_VER,
			  sizeof(CLIENT_HW_VER),
			  sizeof(CLIENT_HW_VER), LWM2M_RES_DATA_FLAG_RO);

	/* AMI sensor objects (Voltage, Current, Energy, PF) */
	init_ami_objects();

	/* LED control */
	init_led_device();

	/* Firmware Update (Object 5) */
	if (IS_ENABLED(CONFIG_LWM2M_FIRMWARE_UPDATE_OBJ_SUPPORT)) {
		init_firmware_update();
	}

	return 0;
}

/* ------------------------------------------------------------------ */
/* RD Client event callback                                            */
/* ------------------------------------------------------------------ */

static void rd_client_event(struct lwm2m_ctx *client,
			    enum lwm2m_rd_client_event client_event)
{
	switch (client_event) {
	case LWM2M_RD_CLIENT_EVENT_NONE:
		break;
	case LWM2M_RD_CLIENT_EVENT_REGISTRATION_COMPLETE:
		LOG_INF("LwM2M registration complete");
		if (gpio_is_ready_dt(&led_status)) {
			gpio_pin_set_dt(&led_status, 1);
		}
		break;
	case LWM2M_RD_CLIENT_EVENT_REGISTRATION_FAILURE:
		LOG_ERR("LwM2M registration failure");
		break;
	case LWM2M_RD_CLIENT_EVENT_REG_UPDATE_COMPLETE:
		LOG_DBG("LwM2M registration update complete");
		break;
	case LWM2M_RD_CLIENT_EVENT_REG_TIMEOUT:
		LOG_WRN("LwM2M registration timeout");
		break;
	case LWM2M_RD_CLIENT_EVENT_DISCONNECT:
		LOG_WRN("LwM2M disconnected");
		if (gpio_is_ready_dt(&led_status)) {
			gpio_pin_set_dt(&led_status, 0);
		}
		break;
	case LWM2M_RD_CLIENT_EVENT_NETWORK_ERROR:
		LOG_ERR("LwM2M network error — stopping client");
		lwm2m_rd_client_stop(client, rd_client_event, true);
		break;
	default:
		LOG_DBG("LwM2M RD event: %d", client_event);
		break;
	}
}

/* ------------------------------------------------------------------ */
/* Network events (L4 connected / disconnected via conn_mgr)           */
/* ------------------------------------------------------------------ */

static void on_net_event_l4_connected(void)
{
	LOG_INF("Network connected (L4 up)");
	k_sem_give(&network_connected_sem);
	lwm2m_engine_resume();
}

static void on_net_event_l4_disconnected(void)
{
	LOG_INF("Network disconnected (L4 down)");
	lwm2m_engine_pause();
}

static void l4_event_handler(struct net_mgmt_event_callback *cb,
			     uint64_t event, struct net_if *iface)
{
	switch (event) {
	case NET_EVENT_L4_CONNECTED:
		LOG_INF("IP Up");
		on_net_event_l4_connected();
		break;
	case NET_EVENT_L4_DISCONNECTED:
		LOG_INF("IP Down");
		on_net_event_l4_disconnected();
		break;
	default:
		break;
	}
}

static void connectivity_event_handler(struct net_mgmt_event_callback *cb,
				       uint64_t event, struct net_if *iface)
{
	if (event == NET_EVENT_CONN_IF_FATAL_ERROR) {
		LOG_ERR("Fatal connectivity error");
	}
}

/* ------------------------------------------------------------------ */
/* main()                                                              */
/* ------------------------------------------------------------------ */

int main(void)
{
	uint32_t flags = IS_ENABLED(CONFIG_LWM2M_RD_CLIENT_SUPPORT_BOOTSTRAP) ?
			 LWM2M_RD_CLIENT_FLAG_BOOTSTRAP : 0;
	int ret;

	LOG_INF(APP_BANNER);
	LOG_INF("Board: %s", CONFIG_BOARD);

	k_sem_init(&quit_lock, 0, K_SEM_MAX_LIMIT);

	/* LED init */
	if (gpio_is_ready_dt(&led_status)) {
		gpio_pin_configure_dt(&led_status, GPIO_OUTPUT_INACTIVE);
	}

	/*
	 * Inject raw Active Dataset TLVs from the OTBR.
	 * This overrides the Kconfig-based dataset for byte-for-byte match
	 * with the OTBR, ensuring partition merge.
	 */
	ret = thread_inject_dataset();
	if (ret < 0) {
		LOG_WRN("Dataset injection failed (%d), using Kconfig defaults", ret);
	}

	/*
	 * Network lifecycle via conn_mgr:
	 * OpenThread L2 brings up the interface; conn_mgr detects L4
	 * connectivity (IPv6 address assigned) and fires the event.
	 */
	if (IS_ENABLED(CONFIG_NET_CONNECTION_MANAGER)) {
		struct net_if *iface = net_if_get_default();

		if (!iface) {
			LOG_ERR("No network interface!");
			return -ENODEV;
		}

		net_mgmt_init_event_callback(&l4_cb, l4_event_handler,
					     NET_EVENT_L4_CONNECTED |
					     NET_EVENT_L4_DISCONNECTED);
		net_mgmt_add_event_callback(&l4_cb);

		net_mgmt_init_event_callback(&conn_cb, connectivity_event_handler,
					     NET_EVENT_CONN_IF_FATAL_ERROR);
		net_mgmt_add_event_callback(&conn_cb);

		ret = net_if_up(iface);
		if (ret < 0 && ret != -EALREADY) {
			LOG_ERR("net_if_up error: %d", ret);
			return ret;
		}

		(void)conn_mgr_if_connect(iface);

		LOG_INF("Waiting for Thread network connectivity...");
		k_sem_take(&network_connected_sem, K_FOREVER);
		LOG_INF("Thread network ready");
	}

	/* Setup all LwM2M objects */
	ret = lwm2m_setup();
	if (ret < 0) {
		LOG_ERR("LwM2M setup failed: %d", ret);
		return ret;
	}

	/* Start RD client */
	memset(&client_ctx, 0, sizeof(client_ctx));
	lwm2m_rd_client_start(&client_ctx, endpoint, flags,
			      rd_client_event, NULL);
	LOG_INF("LwM2M RD client started, endpoint: %s", endpoint);

	/* Application loop — update simulated sensor data */
	while (1) {
		/* Generate dummy meter readings (replace with real DLMS/Modbus) */
		double voltage = 220.0 + (double)(sys_rand32_get() % 200) / 10.0 - 10.0;
		double current = 5.0 + (double)(sys_rand32_get() % 100) / 100.0 - 0.5;
		double energy_kwh = 12345.678 + (double)(sys_rand32_get() % 1000) / 1000.0;
		double power_factor = 0.95 + (double)(sys_rand32_get() % 50) / 1000.0;

		lwm2m_set_f64(&LWM2M_OBJ(3316, 0, 5700), voltage);
		lwm2m_set_f64(&LWM2M_OBJ(3317, 0, 5700), current);
		lwm2m_set_f64(&LWM2M_OBJ(3300, 0, 5700), energy_kwh);
		lwm2m_set_f64(&LWM2M_OBJ(3300, 1, 5700), power_factor);

		LOG_INF("Meter: %.1fV, %.2fA, %.3fkWh, PF=%.3f",
			voltage, current, energy_kwh, power_factor);

		/* LED blink while operational */
		if (gpio_is_ready_dt(&led_status)) {
			gpio_pin_toggle_dt(&led_status);
		}

		k_sleep(K_MINUTES(2));
	}

	return 0;
}
```

## src/ami_objects.c
```c
/*
 * ami_objects.c — AMI-specific LwM2M IPSO objects
 *
 * Registers:
 *   Object 3316 / Instance 0 — Voltage Sensor  (Vrms)
 *   Object 3317 / Instance 0 — Current Sensor   (Arms)
 *   Object 3300 / Instance 0 — Generic Sensor    (Energy kWh)
 *   Object 3300 / Instance 1 — Generic Sensor    (Power Factor)
 */

#include <zephyr/kernel.h>
#include <zephyr/logging/log.h>
#include <zephyr/net/lwm2m.h>

LOG_MODULE_DECLARE(ami_lwm2m_client, LOG_LEVEL_DBG);

/* Units strings */
static const char unit_volt[] = "V";
static const char unit_amp[]  = "A";
static const char unit_kwh[]  = "kWh";
static const char unit_pf[]   = "";

/* Application type descriptions */
static const char type_voltage[] = "Voltage RMS";
static const char type_current[] = "Current RMS";
static const char type_energy[]  = "Active Energy";
static const char type_pf[]      = "Power Factor";

/* --- helper: create one IPSO sensor instance --- */
static int create_sensor(uint16_t obj_id, uint16_t inst_id,
			 const char *units, size_t unit_len,
			 const char *app_type, size_t app_type_len,
			 double min_val, double max_val,
			 double initial_val)
{
	int ret;
	struct lwm2m_obj_path path;

	path = LWM2M_OBJ(obj_id, inst_id);
	ret = lwm2m_create_object_inst(&path);
	if (ret < 0) {
		LOG_ERR("Failed to create obj %u/%u: %d", obj_id, inst_id, ret);
		return ret;
	}

	/* 5700 — Sensor Value */
	lwm2m_set_f64(&LWM2M_OBJ(obj_id, inst_id, 5700), initial_val);

	/* 5701 — Units */
	lwm2m_set_res_buf(&LWM2M_OBJ(obj_id, inst_id, 5701),
			  (void *)units, unit_len, unit_len,
			  LWM2M_RES_DATA_FLAG_RO);

	/* 5603 — Min Range Value */
	lwm2m_set_f64(&LWM2M_OBJ(obj_id, inst_id, 5603), min_val);

	/* 5604 — Max Range Value */
	lwm2m_set_f64(&LWM2M_OBJ(obj_id, inst_id, 5604), max_val);

	/* 5750 — Application Type */
	lwm2m_set_res_buf(&LWM2M_OBJ(obj_id, inst_id, 5750),
			  (void *)app_type, app_type_len, app_type_len,
			  LWM2M_RES_DATA_FLAG_RO);

	LOG_INF("Created IPSO %u/%u (%s)", obj_id, inst_id, app_type);
	return 0;
}

/* --- public init — called from main after conn_mgr is ready --- */
int init_ami_objects(void)
{
	int ret;

	/* Voltage Sensor — Object 3316 / Instance 0 */
	ret = create_sensor(3316, 0,
			    unit_volt, sizeof(unit_volt),
			    type_voltage, sizeof(type_voltage),
			    0.0, 300.0, 220.0);
	if (ret < 0) return ret;

	/* Current Sensor — Object 3317 / Instance 0 */
	ret = create_sensor(3317, 0,
			    unit_amp, sizeof(unit_amp),
			    type_current, sizeof(type_current),
			    0.0, 100.0, 5.0);
	if (ret < 0) return ret;

	/* Energy (kWh) — Generic Sensor 3300 / Instance 0 */
	ret = create_sensor(3300, 0,
			    unit_kwh, sizeof(unit_kwh),
			    type_energy, sizeof(type_energy),
			    0.0, 999999.999, 12345.678);
	if (ret < 0) return ret;

	/* Power Factor — Generic Sensor 3300 / Instance 1 */
	ret = create_sensor(3300, 1,
			    unit_pf, sizeof(unit_pf),
			    type_pf, sizeof(type_pf),
			    0.0, 1.0, 0.95);
	if (ret < 0) return ret;

	LOG_INF("AMI IPSO objects initialised (3316, 3317, 3300x2)");
	return 0;
}
```

## src/firmware_update.c
```c
/*
 * firmware_update.c — LwM2M Firmware Update Object (5)
 *
 * Provides FOTA callbacks for MCUboot-based firmware update.
 * Simplified from the Zephyr LwM2M sample.
 */

#include <zephyr/kernel.h>
#include <zephyr/logging/log.h>
#include <zephyr/net/lwm2m.h>

LOG_MODULE_DECLARE(ami_lwm2m_client, LOG_LEVEL_DBG);

#ifdef CONFIG_LWM2M_FIRMWARE_UPDATE_OBJ_SUPPORT

static uint8_t firmware_buf[64];

static void *firmware_get_buf(uint16_t obj_inst_id,
			      uint16_t res_id,
			      uint16_t res_inst_id,
			      size_t *data_len)
{
	*data_len = sizeof(firmware_buf);
	return firmware_buf;
}

static int firmware_block_received_cb(uint16_t obj_inst_id,
				      uint16_t res_id,
				      uint16_t res_inst_id,
				      uint8_t *data, uint16_t data_len,
				      bool last_block,
				      size_t total_size, size_t offset)
{
	LOG_INF("FOTA block: offset=%zu len=%u last=%d total=%zu",
		offset, data_len, last_block, total_size);
	return 0;
}

static int firmware_update_cb(uint16_t obj_inst_id,
			      uint8_t *args, uint16_t args_len)
{
	LOG_INF("FOTA update requested");
	/* MCUboot will swap the images on next reboot */
	return 0;
}

#endif /* CONFIG_LWM2M_FIRMWARE_UPDATE_OBJ_SUPPORT */

int init_firmware_update(void)
{
#ifdef CONFIG_LWM2M_FIRMWARE_UPDATE_OBJ_SUPPORT
	lwm2m_firmware_set_write_cb(firmware_block_received_cb);
	lwm2m_firmware_set_update_cb(firmware_update_cb);
	LOG_INF("Firmware Update object initialised");
#endif
	return 0;
}
```

## src/led.c
```c
/*
 * led.c — LwM2M Light Control Object (3311)
 *
 * Provides on/off control of the board LED via LwM2M Object 3311.
 * Based on the Zephyr LwM2M sample led.c.
 */

#include <zephyr/kernel.h>
#include <zephyr/logging/log.h>
#include <zephyr/drivers/gpio.h>
#include <zephyr/net/lwm2m.h>

LOG_MODULE_DECLARE(ami_lwm2m_client, LOG_LEVEL_DBG);

static const struct gpio_dt_spec led_dev =
	GPIO_DT_SPEC_GET_OR(DT_ALIAS(led0), gpios, {0});
static bool led_state;

static int led_on_off_cb(uint16_t obj_inst_id, uint16_t res_id,
			 uint16_t res_inst_id, uint8_t *data,
			 uint16_t data_len, bool last_block,
			 size_t total_size, size_t offset)
{
	int ret = 0;
	bool new_state = *(bool *)data;

	if (!gpio_is_ready_dt(&led_dev)) {
		return -ENODEV;
	}

	ret = gpio_pin_set_dt(&led_dev, new_state);
	if (ret) {
		LOG_ERR("LED set failed: %d", ret);
		return ret;
	}

	led_state = new_state;
	LOG_INF("LED %s", led_state ? "ON" : "OFF");
	return 0;
}

int init_led_device(void)
{
	if (!gpio_is_ready_dt(&led_dev)) {
		LOG_WRN("LED device not ready (led0 alias missing?)");
		return -ENODEV;
	}

	gpio_pin_configure_dt(&led_dev, GPIO_OUTPUT_INACTIVE);

	lwm2m_create_object_inst(&LWM2M_OBJ(3311, 0));
	lwm2m_register_post_write_callback(&LWM2M_OBJ(3311, 0, 5850),
					   led_on_off_cb);
	lwm2m_set_bool(&LWM2M_OBJ(3311, 0, 5850), false);

	LOG_INF("LED control object (3311) initialised");
	return 0;
}
```

## src/modules.h
```c
/*
 * modules.h — AMI LwM2M Client module declarations
 */

#ifndef MODULES_H_
#define MODULES_H_

/**
 * Initialize AMI-specific LwM2M objects:
 *   Object 3316 (Voltage Sensor)
 *   Object 3317 (Current Sensor)
 *   Object 3300 instance 0 (Energy kWh)
 *   Object 3300 instance 1 (Power Factor)
 */
int init_ami_objects(void);

/**
 * Initialize LwM2M firmware update object (Object 5).
 */
int init_firmware_update(void);

/**
 * Initialize LED control via LwM2M Object 3311 (Light Control).
 */
int init_led_device(void);

/**
 * Inject the raw Active Dataset TLVs from the OTBR into OpenThread,
 * so the node joins the exact same partition (byte-for-byte match).
 *
 * Must be called AFTER OpenThread is initialized but BEFORE Thread starts.
 * With Zephyr's conn_mgr / OpenThread L2, the dataset can also be set
 * via Kconfig — this function overrides with raw TLVs for guaranteed match.
 */
int thread_inject_dataset(void);

#endif /* MODULES_H_ */
```

## src/thread_dataset.c
```c
/*
 * thread_dataset.c — Inject raw Active Dataset TLVs
 *
 * Copies the pre-built Active Dataset (exported from the OTBR) byte-for-byte
 * into the OpenThread stack using otDatasetSetActiveTlvs().
 *
 * This ensures the XIAO ESP32-C6 node joins the exact same Thread partition
 * as the OTBR, with identical Security Policy, PSKc, Timestamp, etc.
 *
 * Network: AMI-Pilot-2025  Channel: 25  PAN: 0xABCD
 */

#include <zephyr/kernel.h>
#include <zephyr/logging/log.h>
#include <zephyr/net/openthread.h>

#include <openthread/dataset.h>
#include <openthread/instance.h>
#include <openthread/ip6.h>
#include <openthread/thread.h>

LOG_MODULE_DECLARE(ami_lwm2m_client, LOG_LEVEL_DBG);

/*
 * Active Dataset — raw TLV encoding exported from the OTBR.
 * Must match EXACTLY for partition merge.
 *
 * Decoded contents:
 *   Active Timestamp: 1
 *   Channel:          25
 *   Channel Mask:     0x07fff800
 *   Ext PAN ID:       fdc6:63fd:328d:66df
 *   Mesh Local Pfix:  fdc6:63fd:328d:66df::/64
 *   Network Key:      00112233445566778899aabbccddeeff
 *   Network Name:     AMI-Pilot-2025
 *   PAN ID:           0xABCD
 *   PSKc:             1234567890abcdef (derived)
 *   Security Policy:  672 onrc 0
 */
static const uint8_t otbr_dataset_raw[] = {
	0x0e, 0x08, 0x00, 0x00, 0x00, 0x00, 0x00, 0x01,
	0x00, 0x00, 0x4a, 0x03, 0x00, 0x00, 0x0d, 0x35,
	0x06, 0x00, 0x04, 0x00, 0x1f, 0xff, 0xe0, 0x07,
	0x08, 0xfd, 0xc6, 0x63, 0xfd, 0x32, 0x8d, 0x66,
	0xdf, 0x04, 0x10, 0x9d, 0x53, 0x61, 0xd2, 0x4a,
	0x2d, 0x51, 0x80, 0x78, 0xeb, 0x9f, 0x8b, 0xc1,
	0x96, 0x5b, 0x80, 0x0c, 0x04, 0x02, 0xa0, 0xf7,
	0xf8, 0x00, 0x03, 0x00, 0x19, 0x01, 0x02, 0xab,
	0xcd, 0x02, 0x08, 0x12, 0x34, 0x56, 0x78, 0x90,
	0xab, 0xcd, 0xef, 0x03, 0x0e, 0x41, 0x4d, 0x49,
	0x2d, 0x50, 0x69, 0x6c, 0x6f, 0x74, 0x2d, 0x32,
	0x30, 0x32, 0x35, 0x05, 0x10, 0x00, 0x11, 0x22,
	0x33, 0x44, 0x55, 0x66, 0x77, 0x88, 0x99, 0xaa,
	0xbb, 0xcc, 0xdd, 0xee, 0xff
};

int thread_inject_dataset(void)
{
	otError err;
	otOperationalDatasetTlvs dataset_tlvs;
	struct openthread_context *ot_ctx;

	ot_ctx = openthread_get_default_context();
	if (!ot_ctx) {
		LOG_ERR("Failed to get OpenThread context");
		return -ENODEV;
	}

	if (sizeof(otbr_dataset_raw) > sizeof(dataset_tlvs.mTlvs)) {
		LOG_ERR("Dataset too large (%zu > %zu)",
			sizeof(otbr_dataset_raw),
			sizeof(dataset_tlvs.mTlvs));
		return -ENOSPC;
	}

	memcpy(dataset_tlvs.mTlvs, otbr_dataset_raw,
	       sizeof(otbr_dataset_raw));
	dataset_tlvs.mLength = sizeof(otbr_dataset_raw);

	openthread_api_mutex_lock(ot_ctx);

	/* Try direct injection first */
	err = otDatasetSetActiveTlvs(ot_ctx->instance, &dataset_tlvs);

	if (err == OT_ERROR_INVALID_STATE) {
		/*
		 * Thread auto-started before main(). Must tear down the stack,
		 * inject dataset, and restart.  Order matters:
		 *   1. otThreadSetEnabled(false)
		 *   2. otIp6SetEnabled(false)
		 *   3. otDatasetSetActiveTlvs()
		 *   4. otIp6SetEnabled(true)
		 *   5. otThreadSetEnabled(true)
		 */
		LOG_WRN("Thread active — stopping for dataset injection");

		otError e = otThreadSetEnabled(ot_ctx->instance, false);
		if (e != OT_ERROR_NONE) {
			LOG_ERR("otThreadSetEnabled(false): %d", e);
		}

		e = otIp6SetEnabled(ot_ctx->instance, false);
		if (e != OT_ERROR_NONE) {
			LOG_ERR("otIp6SetEnabled(false): %d", e);
		}

		err = otDatasetSetActiveTlvs(ot_ctx->instance, &dataset_tlvs);
		if (err != OT_ERROR_NONE) {
			LOG_ERR("otDatasetSetActiveTlvs (2nd attempt): %d", err);
			openthread_api_mutex_unlock(ot_ctx);
			return -EIO;
		}

		e = otIp6SetEnabled(ot_ctx->instance, true);
		if (e != OT_ERROR_NONE) {
			LOG_ERR("otIp6SetEnabled(true): %d", e);
		}

		e = otThreadSetEnabled(ot_ctx->instance, true);
		if (e != OT_ERROR_NONE) {
			LOG_ERR("otThreadSetEnabled(true): %d", e);
		}
	} else if (err != OT_ERROR_NONE) {
		LOG_ERR("otDatasetSetActiveTlvs failed: %d", err);
		openthread_api_mutex_unlock(ot_ctx);
		return -EIO;
	}

	openthread_api_mutex_unlock(ot_ctx);

	LOG_INF("Active Dataset injected (%zu bytes)", sizeof(otbr_dataset_raw));
	return 0;
}
```
